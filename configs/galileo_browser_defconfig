## configs/galileo_browser_defconfig
```kconfig
# Galileo Gen 2 "browser" — glibc 纯浏览器版:NetSurf + 完整桌面,零多余软件
# 桌面: openbox + pcmanfm(壁纸/图标) + DejaVu/wqy 字体
BR2_x86_x1000=y
BR2_TOOLCHAIN_BUILDROOT_WCHAR=y
BR2_TOOLCHAIN_BUILDROOT_CXX=y
BR2_INSTALL_LIBSTDCPP=y
BR2_ROOTFS_DEVICE_CREATION_DYNAMIC_MDEV=y
BR2_TARGET_GENERIC_GETTY_PORT="ttyS1"
BR2_TARGET_GENERIC_GETTY_BAUDRATE_115200=y
BR2_TARGET_GENERIC_ROOT_PASSWD="galileo"
BR2_ROOTFS_OVERLAY="board/intel/galileo/rootfs_overlay board/intel/galileo/rootfs_overlay_v2 board/intel/galileo/rootfs_overlay_v5"
BR2_ROOTFS_POST_BUILD_SCRIPT="board/intel/galileo/post-build.sh"
BR2_ROOTFS_POST_IMAGE_SCRIPT="board/intel/galileo/post-image.sh"
BR2_LINUX_KERNEL=y
BR2_LINUX_KERNEL_CUSTOM_VERSION=y
BR2_LINUX_KERNEL_CUSTOM_VERSION_VALUE="5.10.29"
BR2_LINUX_KERNEL_USE_CUSTOM_CONFIG=y
BR2_LINUX_KERNEL_CUSTOM_CONFIG_FILE="board/intel/galileo/linux-rx580.config"
BR2_LINUX_KERNEL_INSTALL_TARGET=y
BR2_TARGET_ROOTFS_EXT2=y
BR2_TARGET_ROOTFS_EXT2_4=y
BR2_TARGET_ROOTFS_EXT2_SIZE="700M"
BR2_TARGET_GRUB2=y
BR2_TARGET_GRUB2_I386_EFI=y
BR2_PACKAGE_HOST_DOSFSTOOLS=y
BR2_PACKAGE_HOST_GENIMAGE=y
BR2_PACKAGE_HOST_MTOOLS=y

# HD 6450 显示 + GPU 加速(glamor)
BR2_PACKAGE_LINUX_FIRMWARE=y
BR2_PACKAGE_LINUX_FIRMWARE_RADEON=y
BR2_PACKAGE_XORG7=y
BR2_PACKAGE_XSERVER_XORG_SERVER=y
BR2_PACKAGE_XSERVER_XORG_SERVER_MODULAR=y
BR2_PACKAGE_XDRIVER_XF86_INPUT_EVDEV=y
BR2_PACKAGE_XDRIVER_XF86_INPUT_KEYBOARD=y
BR2_PACKAGE_XDRIVER_XF86_INPUT_MOUSE=y
BR2_PACKAGE_XAPP_XINIT=y
BR2_PACKAGE_XTERM=y
BR2_PACKAGE_OPENBOX=y
BR2_PACKAGE_MESA3D=y
BR2_PACKAGE_MESA3D_GALLIUM_DRIVER_R600=y
BR2_PACKAGE_MESA3D_OPENGL_EGL=y
BR2_PACKAGE_MESA3D_OPENGL_GLX=y
BR2_PACKAGE_LIBEPOXY=y

# 浏览器 + HTTPS
BR2_PACKAGE_NETSURF=y
BR2_PACKAGE_NETSURF_GTK=y
BR2_PACKAGE_LIBCURL=y
BR2_PACKAGE_LIBOPENSSL=y
BR2_PACKAGE_OPENSSL=y

# 基础桌面(pcmanfm 壁纸/图标)
BR2_PACKAGE_LIBGTK2=y
BR2_PACKAGE_LIBFM=y
BR2_PACKAGE_MENU_CACHE=y
BR2_PACKAGE_PCMANFM=y
BR2_PACKAGE_CAIRO_PDF=y

# 基础系统
BR2_PACKAGE_DROPBEAR=y
BR2_PACKAGE_BUSYBOX_SHOW_OTHERS=y
BR2_PACKAGE_BASH=y
BR2_LINUX_KERNEL_NEEDS_HOST_OPENSSL=y
BR2_CCACHE=y
BR2_CCACHE=y
```

## package/dosbox/Config.in
```kconfig
config BR2_PACKAGE_DOSBOX
	bool "dosbox"
	depends on BR2_INSTALL_LIBSTDCPP
	depends on BR2_USE_MMU
	select BR2_PACKAGE_SDL
	select BR2_PACKAGE_SDL_SOUND
	select BR2_PACKAGE_ALSA_LIB
	select BR2_PACKAGE_LIBPNG
	select BR2_PACKAGE_ZLIB
	help
	  DOSBox emulates an x86 PC with sound and graphics, for
	  running old DOS games.

	  http://www.dosbox.com
```

## package/dosdrm/Config.in
```kconfig
config BR2_PACKAGE_DOSDRM
	bool "dosdrm"
	depends on BR2_PACKAGE_LIBDRM
	help
	  DRM/KMS diagnostic for the fbcon DOS appliance: probe (driver,
	  atomic support, plane scaling limits), fit (pick the connector mode
	  that matches the emulator frame), scale (GPU plane upscale prototype)
	  and bench (framebuffer write cost).

	  Used to verify on the real board whether hardware plane scaling is
	  available; without it the image falls back to CRT mode == frame size
	  so the monitor's scaler does the upscale.
```

## package/openarena/Config.in
```kconfig
config BR2_PACKAGE_OPENARENA
	bool "openarena (free Quake III Arena data + i386 engine)"
	depends on BR2_PACKAGE_SDL
	help
	  OpenArena 0.8.8: a Quake III Arena compatible game with free
	  (GPL/CC) assets, shipped here with the prebuilt i386 engine binary.

	  Used mainly as an automated GPU/CPU benchmark target: the q3bench
	  helper runs a timedemo and prints the resulting fps.

	  https://openarena.ws
```

## package/x11r7/xdriver_xf86-video-ati/Config.in
```kconfig
config BR2_PACKAGE_XDRIVER_XF86_VIDEO_ATI
	bool "xf86-video-ati"
	select BR2_PACKAGE_LIBDRM
	select BR2_PACKAGE_LIBDRM_RADEON
	select BR2_PACKAGE_XLIB_LIBXCOMPOSITE
	select BR2_PACKAGE_XORGPROTO
	help
	  ATI video driver

	  Patched: mesa3d dependency dropped. We only need the EXA 2D path
	  (libdrm_radeon); DRI is auto-disabled by configure when mesa is
	  absent, glamor is disabled without EGL/GL.
```
